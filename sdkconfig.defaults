## sdkconfig.defaults
```kconfig
# Target Configuration
CONFIG_IDF_TARGET_ESP32S3=y

# ESP32S3-Specific
CONFIG_ESP32S3_DEFAULT_CPU_FREQ_240=y
CONFIG_ESP32S3_REV_MIN_FULL=0

# SPI Flash Configuration
CONFIG_ESPTOOLPY_FLASHSIZE_4MB=y
CONFIG_ESPTOOLPY_FLASHFREQ_80M=y
CONFIG_ESPTOOLPY_FLASHMODE_QIO=y

# PSRAM Configuration (M5atomS3R - 8MB PSRAM)
CONFIG_SPIRAM=y
CONFIG_SPIRAM_MODE_OCT=y
CONFIG_SPIRAM_TYPE_ESPPSRAM64=y
CONFIG_SPIRAM_SPEED_40M=y
CONFIG_SPIRAM_BOOT_INIT=y
CONFIG_SPIRAM_IGNORE_NOTFOUND=y
CONFIG_SPIRAM_USE_MALLOC=y
CONFIG_SPIRAM_MALLOC_ALWAYSINTERNAL=16384
CONFIG_SPIRAM_CACHE_WORKAROUND=y
CONFIG_SPIRAM_TRY_ALLOCATE_WIFI_LWIP=y

# WiFi Configuration (temporarily disabled for build fix)
# CONFIG_ESP32_WIFI_ENABLED=y
# CONFIG_ESP32_WIFI_STATIC_RX_BUFFER_NUM=10
# CONFIG_ESP32_WIFI_DYNAMIC_RX_BUFFER_NUM=32
# CONFIG_ESP32_WIFI_DYNAMIC_TX_BUFFER_NUM=32

# Bluetooth Configuration (temporarily disabled for build fix)
# CONFIG_BT_ENABLED=y
# CONFIG_BT_NIMBLE_ENABLED=y

# FreeRTOS Configuration
CONFIG_FREERTOS_HZ=1000
CONFIG_FREERTOS_USE_TRACE_FACILITY=y
CONFIG_FREERTOS_USE_STATS_FORMATTING_FUNCTIONS=y

# Log Configuration
CONFIG_LOG_DEFAULT_LEVEL_INFO=y
CONFIG_LOG_MAXIMUM_LEVEL_VERBOSE=y
CONFIG_BOOTLOADER_LOG_LEVEL_INFO=y
CONFIG_ESP_PSRAM_LOG_LEVEL_DEBUG=y

# Compiler Configuration
CONFIG_COMPILER_OPTIMIZATION_SIZE=y
CONFIG_COMPILER_CXX_EXCEPTIONS=y

# M5atomS3R specific GPIO settings
# Note: Actual pin configurations are handled in code

# USB Configuration (for debugging)
CONFIG_ESP_CONSOLE_USB_SERIAL_JTAG=y

# Partition Table
CONFIG_PARTITION_TABLE_SINGLE_APP=y

# WDT Configuration
CONFIG_ESP_TASK_WDT_TIMEOUT_S=10
CONFIG_ESP_TASK_WDT_CHECK_IDLE_TASK_CPU0=y
CONFIG_ESP_TASK_WDT_CHECK_IDLE_TASK_CPU1=y
```
